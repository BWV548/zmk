## app/west.yml
```yaml
manifest:
  remotes:
    - name: zephyrproject-rtos
      url-base: https://github.com/zephyrproject-rtos
    - name: zmkfirmware
      url-base: https://github.com/zmkfirmware
    - name: myfork
      url-base: https://github.com/BWV548

  projects:
    - name: nanopb
      remote: myfork
      revision: zmk
      path: modules/lib/nanopb

  self:
    west-commands: scripts/west-commands.yml
```
